    combos {
        compatible = "zmk,combos";
 
          combo_esc_toggle {
            timeout-ms = <100>;
            key-positions = <29 42>;
            bindings = <&kp ESC>;
        };

          combo_num_shift {
            timeout-ms = <50>;
            key-positions = <41 42>;
            bindings = <&mo 4>;
        };
    };
