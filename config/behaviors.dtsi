        tp: tap_toggle_layer {
            compatible = "zmk,behavior-hold-tap";
            label = "TAP_TOGGLE_LAYER";
            #binding-cells = <2>;
            flavor = "hold-preferred";
            quick-tap-ms = <125>;
            tapping-term-ms = <200>;
            bindings = <&mo>, <&kp>;
        };
